/dts-v1/;

/ {

	hypervisor {
		compatible = "hafnium,hafnium";

		vm1 {
			debug_name = "Host VM";
			kernel_filename = "Image";
			ramdisk_filename = "initrd.img";
			smc_whitelist_permissive;
			vcpu_count = <0x04>;
			interrupts = <0x30 0x31 0x32 0x33 0x34 0x35 0x36 0x37 0x38 0x39 0x3a 0x3b 0x3c 0x3d 0x3e 0x3f 0x40 0x41 0x42 0x43 0x44 0x45 0x46 0x47 0x48 0x49 0x4a 0x4b 0x4c 0x4d 0x4e 0x4f 0x27 0x22 0x21 0x2a 0x2b 0x2c 0x17 0x19 0x1d 0x1e 0x1b 0x1a>;
		};

		vm2 {
			debug_name = "Guest VM1";
			vcpu_count = <0x01>;
			mem_size = <0x10000000>;
			kernel_filename = "Image.2";
			fdt_filename = "guest.dtb";
			ramdisk_filename = "initrd.img";
			fdt_address = <0x1024>;
			initrd_address = <0x2048>;
		};
	};
};
